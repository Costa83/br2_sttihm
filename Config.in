## Config.in
```kconfig
source "$BR2_EXTERNAL_STT_PATH/package/gattlib/Config.in"
source "$BR2_EXTERNAL_STT_PATH/package/stt-ihm/Config.in"
```

## package/gattlib/Config.in
```kconfig
config BR2_PACKAGE_GATTLIB
	bool "gattlib: GATT protocol support on bluez"
	depends on BR2_USE_MMU
	depends on BR2_PACKAGE_BLUEZ_UTILS_GATT
	help
		GATT protocol over Bluez
```

## package/stt-ihm/Config.in
```kconfig
config BR2_PACKAGE_STT_IHM
	bool "IHM: gateway"
	depends on BR2_USE_MMU
	select BR2_PACKAGE_JANSSON
	select BR2_PACKAGE_GATTLIB
	help
		Smile Trip Tour Bycicle Dashboard

if BR2_PACKAGE_STT_IHM

config BR2_PACKAGE_STT_IHM_WEB
	bool "web interface"

config BR2_PACKAGE_STT_IHM_DB
	bool "db consumer"
	select BR2_PACKAGE_MONGOC

endif
```
